## build/conf/bblayers.conf
```bitbake
# POKY_BBLAYERS_CONF_VERSION is increased each time build/conf/bblayers.conf
# changes incompatibly
POKY_BBLAYERS_CONF_VERSION = "2"

BBPATH = "${TOPDIR}"
BBFILES ?= ""

BBLAYERS ?= " \
  /home/tungnhs/TungNHS/Yocto-OTA-BBB/poky/meta \
  /home/tungnhs/TungNHS/Yocto-OTA-BBB/poky/meta-poky \
  /home/tungnhs/TungNHS/Yocto-OTA-BBB/poky/meta-yocto-bsp \
  /home/tungnhs/TungNHS/Yocto-OTA-BBB/poky/meta-openembedded/meta-oe \
  /home/tungnhs/TungNHS/Yocto-OTA-BBB/poky/meta-openembedded/meta-python \
  /home/tungnhs/TungNHS/Yocto-OTA-BBB/poky/meta-openembedded/meta-networking \
  /home/tungnhs/TungNHS/Yocto-OTA-BBB/poky/meta-swupdate \
  /home/tungnhs/TungNHS/Yocto-OTA-BBB/poky/meta-bbb \
  "
```

## build/conf/local.conf
```bitbake
# ============================================================================
# BEAGLEBONE BLACK - OTA UPDATE SYSTEM (Production Demo)
# ============================================================================
# Project: SW OTA Update với SWUpdate + Hawkbit
# Target: BeagleBone Black
# Author: TungNHS
# Date: 2026-01-05
# ============================================================================

# ============================================================================
# MACHINE & BUILD CONFIGURATION
# ============================================================================

MACHINE = "beaglebone-yocto"

# Build threads (adjust based on your VM cores)
BB_NUMBER_THREADS = "4"
PARALLEL_MAKE = "-j 4"

# Package management - RPM for production
PACKAGE_CLASSES = "package_rpm"

# Disk space monitoring
BB_DISKMON_DIRS = "\
    STOPTASKS,${TMPDIR},1G,100K \
    STOPTASKS,${DL_DIR},1G,100K \
    STOPTASKS,${SSTATE_DIR},1G,100K \
    STOPTASKS,/tmp,100M,100K \
    HALT,${TMPDIR},100M,1K \
    HALT,${DL_DIR},100M,1K \
    HALT,${SSTATE_DIR},100M,1K \
    HALT,/tmp,10M,1K"

CONF_VERSION = "2"

# ============================================================================
# INIT SYSTEM - SYSTEMD (Required for SWUpdate service)
# ============================================================================

DISTRO_FEATURES:append = " systemd"
DISTRO_FEATURES:remove = "sysvinit"
VIRTUAL-RUNTIME_init_manager = "systemd"
VIRTUAL-RUNTIME_initscripts = "systemd-compat-units"
DISTRO_FEATURES_BACKFILL_CONSIDERED = "sysvinit"

# Serial console for debugging
SERIAL_CONSOLES = "115200;ttyS0"

# ============================================================================
# SWUPDATE - OTA CLIENT
# ============================================================================

# SWUpdate packages
IMAGE_INSTALL:append = " swupdate"
IMAGE_INSTALL:append = " swupdate-www"
IMAGE_INSTALL:append = " swupdate-progress"
IMAGE_INSTALL:append = " u-boot-env "

# U-Boot environment tools for dual-boot switching
IMAGE_INSTALL:append = " libubootenv-bin"
PREFERRED_PROVIDER_u-boot-fw-utils = "libubootenv"

# ============================================================================
# NETWORK & CONNECTIVITY
# ============================================================================

# Network tools
IMAGE_INSTALL:append = " dhcpcd"
IMAGE_INSTALL:append = " iproute2 iputils"

# SSH access
IMAGE_INSTALL:append = " openssh openssh-sftp-server"
IMAGE_FEATURES:append = " ssh-server-openssh"

# HTTP/HTTPS for OTA downloads
IMAGE_INSTALL:append = " curl wget ca-certificates"

# ============================================================================
# SYSTEM UTILITIES (Production essentials)
# ============================================================================

IMAGE_INSTALL:append = " util-linux e2fsprogs"
IMAGE_INSTALL:append = " procps coreutils"
IMAGE_INSTALL:append = " nano"
IMAGE_INSTALL:append = " kernel-modules kernel-devicetree"

# ============================================================================
# DEBUG TOOLS (Optional - for demo/development)
# ============================================================================

# Uncomment for debugging:
# IMAGE_INSTALL:append = " htop strace lsof"
# IMAGE_INSTALL:append = " tcpdump"

# ============================================================================
# STORAGE & FILESYSTEM - DUAL-BOOT SETUP
# ============================================================================

# ============================================================================
# DUAL-BOOT WIC CONFIGURATION
# ============================================================================
WKS_FILE = "bbb-dual-boot.wks"

# Image formats (WIC for SD card with partitions)
IMAGE_FSTYPES = "ext4 tar.xz wic wic.gz wic.bmap"

# Extra space for rootfs (in KB)
IMAGE_ROOTFS_EXTRA_SPACE = "300000"

# ============================================================================
# U-BOOT CONFIGURATION (CRITICAL FOR BEAGLEBONE BLACK)
# ============================================================================

# U-Boot machine configuration for AM335x
UBOOT_MACHINE = "am335x_evm_defconfig"

# Preferred U-Boot provider
PREFERRED_PROVIDER_virtual/bootloader = "u-boot"
PREFERRED_PROVIDER_u-boot = "u-boot"

# Boot partition files - these will be placed in /boot partition
IMAGE_BOOT_FILES = " \
    MLO \
    u-boot.img \
    ${KERNEL_IMAGETYPE} \
    ${KERNEL_DEVICETREE} \
    boot.scr \
    uEnv.txt \
"

# Kernel configuration
KERNEL_IMAGETYPE = "zImage"
KERNEL_DEVICETREE = "am335x-boneblack.dtb"

# WIC depends on u-boot to generate MLO and u-boot-script for boot.scr
WKS_FILE_DEPENDS = "u-boot u-boot-script"

# ============================================================================
# U-BOOT CONFIGURATION (Dual-boot support)
# ============================================================================

# Disable extlinux - use boot.scr instead for dual-boot logic
UBOOT_EXTLINUX = "0"

# U-Boot environment for A/B partition switching
# UBOOT_ENV = "uEnv"  # Commented out - file not provided

# ============================================================================
# SECURITY & USER MANAGEMENT
# ============================================================================

# Root password = "root" (CHANGE IN PRODUCTION!)
EXTRA_USERS_PARAMS = "usermod -P root root;"

# Debug tweaks (DISABLE IN PRODUCTION!)
EXTRA_IMAGE_FEATURES = "debug-tweaks"

# For production, comment above and uncomment below:
# EXTRA_USERS_PARAMS = "usermod -P 'your-secure-password-hash' root;"
# Remove debug-tweaks and empty password

# ============================================================================
# SYSTEM INFO
# ============================================================================

IMAGE_LINGUAS = "en-us"
DEFAULT_TIMEZONE = "Asia/Ho_Chi_Minh"
hostname_pn-base-files = "bbb-ota"

# ============================================================================
# BUILD OPTIMIZATION
# ============================================================================

# Source mirror (faster downloads)
INHERIT += "own-mirrors"
SOURCE_MIRROR_URL = "http://downloads.yoctoproject.org/mirror/sources/"

# Shared state cache (faster rebuilds)
SSTATE_DIR ?= "${TOPDIR}/sstate-cache"
DL_DIR ?= "${TOPDIR}/downloads"

# Clean work dir after build (save disk space - optional)
# WARNING: Disable for debugging!
INHERIT += "rm_work"
RM_WORK_EXCLUDE += "swupdate linux-yocto core-image-base"

# ============================================================================
# IMAGE TARGET - Use core-image-base for OTA demo
# ============================================================================
# Build command: bitbake core-image-base
```

## meta-bbb/wic/bbb-dual-boot.wks
```
# BeagleBone Black Dual-Boot WIC Layout
# =====================================
# Based on official meta-yocto-bsp/wic/beaglebone-yocto.wks
# Modified for dual-boot A/B partition scheme

# Partition 1: Boot partition (MLO, U-Boot, kernel, DTB, boot script)
# FIXED: Remove loader=u-boot to prevent auto-generation of extlinux.conf
part /boot --source bootimg-partition --ondisk mmcblk0 --fstype=vfat --label boot --active --align 4 --fixed-size 32 --use-uuid

# Partition 2: Root filesystem A (Active OS)
# 4GB - enough for rootfs + OTA extraction space
part / --source rootfs --ondisk mmcblk0 --fstype=ext4 --label rootfs_a --align 4 --fixed-size 4096 --use-uuid

# Partition 3: Root filesystem B (Standby for OTA updates)
# Same size as partition A for dual-boot compatibility
part /standby --source rootfs --ondisk mmcblk0 --fstype=ext4 --label rootfs_b --align 4 --fixed-size 4096 --use-uuid

# Partition 4: Data partition (Persistent user data, logs, firmware packages)
# 4GB for user data, logs, and OTA packages
part /data --ondisk mmcblk0 --fstype=ext4 --label data --align 4 --fixed-size 4096 --use-uuid

# Bootloader configuration - append kernel command line
bootloader --append="console=ttyS0,115200"
```
